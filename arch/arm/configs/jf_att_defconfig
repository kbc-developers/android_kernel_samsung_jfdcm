## arch/arm/configs/jf_att_defconfig
```kconfig
CONFIG_MACH_JF_ATT=y
CONFIG_EXTRA_FIRMWARE="audience-es325-fw.bin"
CONFIG_EXTRA_FIRMWARE_DIR="firmware"
CONFIG_IRDA_MC96=y
# InsideSecure VPN Client
CONFIG_INSIDESECURE_VPNCLIENT=y
CONFIG_CFG80211_REG_NOT_UPDATED=y
```

## arch/arm/configs/jf_cri_defconfig
```kconfig
CONFIG_MACH_JF_CRI=y
CONFIG_EXTRA_FIRMWARE="audience-es325-fw.bin"
CONFIG_EXTRA_FIRMWARE_DIR="firmware"
CONFIG_INSIDESECURE_VPNCLIENT=y
CONFIG_CFG80211_REG_NOT_UPDATED=y
```

## arch/arm/configs/jf_dcm_defconfig
```kconfig
CONFIG_MACH_JF_DCM=y
CONFIG_EXTRA_FIRMWARE="audience-es325-fw.bin"
CONFIG_EXFAT_FS=y
CONFIG_EXFAT_DEFAULT_CODEPAGE=437
CONFIG_EXFAT_DEFAULT_IOCHARSET="utf8"
```

## arch/arm/configs/jf_vzw_defconfig
```kconfig
CONFIG_MACH_JF_VZW=y
CONFIG_EXTRA_FIRMWARE="audience-es325-fw-vzw.bin"
CONFIG_EXTRA_FIRMWARE_DIR="firmware"
# InsideSecure VPN Client
CONFIG_INSIDESECURE_VPNCLIENT=y
#VMWARE RELATED
CONFIG_VMWARE_MVP=y
CONFIG_CFG80211_REG_NOT_UPDATED=y

#EPDG
CONFIG_NET_CORE=y
CONFIG_NET_SCH_PRIO=y
CONFIG_NET_SCHED=y   #depends on CONFIG_NET  which is enabled by default.. coz not seeing in the config file
CONFIG_NET_CLS_BASIC=y # required if basic is being used as a filter. depends on CONFIG_NET_CLS so enabling it by default
CONFIG_NET_CLS=y
CONFIG_NET_CLS_ACT=y # for enabling the action target.
CONFIG_NET_ACT_MIRRED=y  # for enabling the mirred target for redirecting the packet between the devices.
CONFIG_NET_EMATCH=y   #basic uses extended matches so this has to be present
CONFIG_NET_SCH_INGRESS=y # classifier for ingress packet
```

## drivers/felica/Kconfig
```kconfig
config FELICA
	bool "FeliCa Driver"
	default n

config NFC_FELICA
	bool "NFC FeliCa Driver"
	default n

config FELICA_NO_SECURE
	bool "FeliCa no secure"
	default n
```
